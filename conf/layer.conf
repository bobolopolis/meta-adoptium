## conf/layer.conf
```bitbake
BBPATH .= ":${LAYERDIR}"

BBFILES += "${LAYERDIR}/recipes*/*/*.bb ${LAYERDIR}/recipes*/*/*.bbappend"

BBFILE_COLLECTIONS += "adoptium"
BBFILE_PATTERN_adoptium := "^${LAYERDIR}/"
BBFILE_PRIORITY_adoptium = "10"
LAYERSERIES_COMPAT_adoptium = "mickledore langdale kirkstone dunfell"
LAYERDEPENDS_adoptium = "openembedded-layer"
```
